## conf/layer.conf
```bitbake
# We have a conf and classes directory, append to BBPATH 
BBPATH .= ":${LAYERDIR}"

# We have a recipes directory, add to BBFILES
#BBFILES += "${LAYERDIR}/recipes-*/*/*.bb ${LAYERDIR}/recipes-*/*/*.bbappend"

BBFILE_COLLECTIONS += "fwup-examples-layer"
BBFILE_PATTERN_fwup-examples-layer := "^${LAYERDIR}/"
BBFILE_PRIORITY_fwup-examples-layer = "8"

LAYERDEPENDS_fwup-examples-layer = "core"
LAYERDEPENDS_fwup-examples-layer += "fwup-layer"

LAYERSERIES_COMPAT_fwup-examples-layer = "walnascar styhead kirkstone scarthgap"

LAYERRECOMMENDS_fwup-examples-layer = "qemu-bsp-layer"

BBFILES_DYNAMIC += " \
   qemu-bsp-layer:${LAYERDIR}/dynamic-layers/qemu-bsp-layer/*/*/*.bb \
   qemu-bsp-layer:${LAYERDIR}/dynamic-layers/qemu-bsp-layer/*/*/*.bbappend \
   "
```

## conf/machine/qemux86-64-grub.conf
```bitbake
#@TYPE: Machine
#@NAME: QEMU x86-64 machine with grub EFI enabled
#@DESCRIPTION: Machine configuration for running an x86-64 system on QEMU
#              Use `runqemu` with ovmf to boot with EFI

require conf/machine/qemux86-64.conf

# Use the same overrides as qemux86-64 machine
MACHINEOVERRIDES:append = ":qemux86-64"

WKS_FILE = "qemux86-64-grub-efi.wks"

FWUP_FILE = "qemux86-64-grub-efi.fwup"

do_image_wic[depends] += "grubenv-boot-image:do_deploy"

EFI_PROVIDER ?= "grub-efi"

do_image_wic[depends] += "gptfdisk-native:do_populate_sysroot"
do_image_wic[recrdeptask] += "do_bootimg"

MACHINE_FEATURES += "efi"

EXTRA_IMAGEDEPENDS += "ovmf"

KMACHINE:qemux86-64 = "qemux86-64"
```
